## boards/shields/kaasch-keys/Kconfig.shield
```kconfig
config SHIELD_KAASCH_KEYS_LEFT
    def_bool $(shields_list_contains,kaasch_keys_left)

config SHIELD_KAASCH_KEYS_RIGHT
    def_bool $(shields_list_contains,kaasch_keys_right)
```

## boards/shields/shields/kaasch-keys/Kconfig.defconfig
```kconfig
if SHIELD_KAASCH_KEYS_LEFT

# Name must be less than 16 characters long!
config ZMK_KAASCH_KEYS
    default "Kaasch Keys"

config ZMK_SPLIT_ROLE_CENTRAL
    default y

endif

if SHIELD_KAASCH_KEYS_LEFT || SHIELD_KAASCH_KEYS_RIGHT

config ZMK_SPLIT
    default y

endif
```

## config/west.yml
```yaml
manifest:
  remotes:
    - name: zmkfirmware
      url-base: https://github.com/zmkfirmware

    - name: kaasch-co
      url-base: https://github.com/kaasch-co

  projects:
    # Together with the above defined remote, this refers to a module located at
    # https://github.com/remote-name/repository-name
    - name: zmk
      remote: zmkfirmware
      revision: main
      import: app/west.yml

    - name: kaasch-keys-zmk
      remote: kaasch-co
      revision: main

  self:
    path: config
```
